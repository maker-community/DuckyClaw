## IM/Kconfig
```kconfig
menu "IM Config"
    config OUTBOUND_STACK_SIZE
        int "IM outbound thread stack size (bytes)"
        default 12288
        help
            Stack size in bytes for the IM outbound thread (default 12*1024).
endmenu
```

## Kconfig
```kconfig
menu "configure app (DuckyClaw) "

config TUYA_PRODUCT_ID
    string "product ID of project"
    default "xxxxxxxxxxxxxxxx"

rsource "TuyaOpen/apps/tuya.ai/ai_components/Kconfig"

rsource "./cron_service/Kconfig"
rsource "./gateway/Kconfig"
rsource "./IM/Kconfig"
rsource "./agent/Kconfig"
rsource "./tools/Kconfig"

endmenu
```

## battery/Kconfig
```kconfig
menuconfig ENABLE_BATTERY_MONITOR
    bool "Enable battery monitor (BQ27220)"
    default y
    help
        Enable BQ27220 battery gauge initialization and reporting.

if ENABLE_BATTERY_MONITOR

menu "Battery Monitor Config"
    config BATTERY_MONITOR_INTERVAL_S
        int "Battery monitor refresh interval (seconds)"
        default 60
        range 1 3600
        help
            Polling or refresh interval for battery status logic.

    config BATTERY_MONITOR_LOW_THRESHOLD_PCT
        int "Low battery threshold (percent)"
        default 15
        range 1 100
        help
            Battery level threshold considered low.

    config BATTERY_MONITOR_DESIGN_CAPACITY_MAH
        int "Battery design capacity (mAh)"
        default 1000
        range 100 20000
        help
            Nominal battery pack capacity written to BQ27220 Data Memory.
            Change this when using a different battery pack so the gauge model
            starts from the correct design capacity.
endmenu

endif
```
